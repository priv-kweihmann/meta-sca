## conf/distro/scatest.conf
```bitbake
# Distro Layer configuration
# DO NOT USE THIS DISTRO FOR SOMETHING PRODUCTIVE
# THIS IS JUST MEANT FOR TESTING
include conf/distro/poky.conf
DISTRO = "scatest"
DISTRO_NAME = "SCA Test distribution"
DISTRO_VERSION = "1.0"
SDK_VENDOR = "-scatestsdk"
SDK_VERSION = "${DISTRO_VERSION}"
MAINTAINER = "kweihmann@outlook.com"

TARGET_VENDOR = "-scatest"

# Override these in poky based distros
DISTRO_EXTRA_RDEPENDS += "packagegroup-core-boot"
DISTRO_EXTRA_RRECOMMENDS += ""

# Remove all audio and graphics related distro backfills
# we do not need them for our purposes
DISTRO_FEATURES_OPTED_OUT:append = " opengl ptest wayland vulkan pulseaudio sysvinit"
DISTRO_FEATURES:append = " systemd usrmerge ext2"

INIT_MANAGER = "systemd"

PACKAGE_CLASSES = "package_ipk"

# SCA specific settings
INHERIT += "rm_work"

# Disable the creation of cache files for 
# python native packages to address this issues
# described at
# https://github.com/priv-kweihmann/meta-sca/issues/1077
# https://github.com/priv-kweihmann/meta-sca/issues/1086
INHERIT += "no-native-pycache"

# Disable SPDX
INHERIT += "no-spdx"

BB_HASHSERVE_DB_DIR = "${SSTATE_DIR}"
```

## conf/layer.conf
```bitbake
BBPATH =. "${LAYERDIR}:"

BBFILES += "\
            ${LAYERDIR}/packagegroups/*.bb \
            ${LAYERDIR}/packagegroups/*.bbappend \
            ${LAYERDIR}/recipes-appends/*.bbappend \
            ${LAYERDIR}/recipes-devtools/*/*.bb \
            ${LAYERDIR}/recipes-devtools/*/*.bbappend \
            ${LAYERDIR}/recipes-go/**.bb \
            ${LAYERDIR}/recipes-perl/*/*.bb \
            ${LAYERDIR}/recipes-perl/*/*.bbappend \
            ${LAYERDIR}/recipes-python/*/*.bb \
            ${LAYERDIR}/recipes-python/*/*.bbappend \
            ${LAYERDIR}/recipes-sca-rules/*/*.bb \
            ${LAYERDIR}/recipes-sca-rules/*/*.bbappend \
            ${LAYERDIR}/recipes-sca/*/*.bb \
            ${LAYERDIR}/recipes-sca/*/*.bbappend \
            ${LAYERDIR}/recipes-support/*/*.bb \
            ${LAYERDIR}/recipes-support/*/*.bbappend \
           "

## Conditionally include recipes based on distro
BBFILES += "\
            ${LAYERDIR}/dynamic-distro/${DISTRO}/*/*.bb \
            ${LAYERDIR}/dynamic-distro/${DISTRO}/*/*.bbappend \
           "

BBFILE_COLLECTIONS += "meta-sca"
BBFILE_PATTERN_meta-sca = "^${LAYERDIR}/"
BBFILE_PRIORITY_meta-sca ?= "1"

SCA_DEFAULT_PREFERENCE ?= "-1"

LAYERVERSION_meta-sca = "1"
LAYERDEPENDS_meta-sca = "core"
SCA_LAYERDIR = "${LAYERDIR}"

LAYERSERIES_COMPAT_meta-sca = "mickledore nanbield"

LICENSE_PATH += "${LAYERDIR}/files/licenses/"

include conf/additional-spdx.conf
```
